## target/linux/sunxi/image/Config.in
```kconfig
config SUNXI_SD_BOOT_PARTSIZE
	int "Boot (SD Card) filesystem partition size (in MB)"
	depends on TARGET_sunxi
	default 20

config SUNXI_IS_BOOT_FROM_MMC1
	bool "Boot HandsomeMod From MMC1"
	depends on TARGET_sunxi
	default n
```

## target/sdk/Config.in
```kconfig
config SDK
	bool "Build the HandsomeMod SDK"
	depends on !EXTERNAL_TOOLCHAIN
	default BUILDBOT
	help
	  This is essentially a stripped-down version of the buildroot
	  with a precompiled toolchain. It can be used to develop and
	  test packages for HandsomeMod before including them in the buildroot
```
